## conf/distro/s6-demo.conf
```bitbake
DISTRO = "s6-demo"
DISTRO_NAME = "Demonstration s6 system"
DISTRO_VERSION = "1"
#DISTRO_VERSION = "1.0+snapshot-${DATE}"
DISTRO_CODENAME = "master"

# Disable pulseaudio and sysvinit
DISTRO_FEATURES_BACKFILL_CONSIDERED = "pulseaudio sysvinit"
PINBALL_DEFAULT_DISTRO_FEATURES = "largefile ptest multiarch"

DISTRO_FEATURES ?= "${DISTRO_FEATURES_DEFAULT} ${DISTRO_FEATURES_LIBC} ${S6_DEMO_DEFAULT_DISTRO_FEATURES}"


VIRTUAL-RUNTIME_initscripts ?= "init"
VIRTUAL-RUNTIME_init_manager ?= "s6 s6-networking s6-portable-utils s6-linux-utils anopa"
VIRTUAL-RUNTIME_dev_manager ?= "busybox"
VIRTUAL-RUNTIME_login_manager ?= ""
PINBALL_DEFAULT_EXTRA_RDEPENDS = "packagegroup-core-boot"
```
